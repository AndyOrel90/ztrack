/*
 * Copyright (c) 2021 The ZMK Contributors
 *
 * SPDX-License-Identifier: MIT
 */

#include <behaviors.dtsi>
#include <dt-bindings/zmk/keys.h>
#include <dt-bindings/zmk/bt.h>
#include <dt-bindings/zmk/outputs.h>
//#include <dt-bindings/zmk/>

#define LOWER 1
#define RAISE 2

#define L_SPC &lt LOWER SPACE
#define R_RET &lt RAISE RET

/ {
    keymap {
        compatible = "zmk,keymap";
        default_layer {
            bindings = <
                &kp Q     &kp W &kp A
            >;
        };
    };
};
